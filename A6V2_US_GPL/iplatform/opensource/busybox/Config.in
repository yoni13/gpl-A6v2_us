## A6V2_US_GPL/iplatform/opensource/busybox/Config.in
```kconfig
if PACKAGE_busybox

config BUSYBOX_CONFIG_NOMMU
	bool
	depends NOMMU
	default y if NOMMU
	deselect BUSYBOX_CONFIG_ASH
	deselect BUSYBOX_CONFIG_FEATURE_SH_IS_ASH
	deselect BUSYBOX_CONFIG_LOCK

config CONFIG_BUSYBOX_CONFIG_FEATURE_SH_IS_HUSH
	bool
	default y if NOMMU
	default n if !NOMMU

config BUSYBOX_CONFIG_HUSH
	bool
	default y if NOMMU
	default n if !NOMMU

config NTP_TIME_GET_ENABLED
	bool "support get ntp status form /tmp/ntp_time_set"
	default n

source "package/feeds/iplatform/busybox/configs/Config.in"

endif
```
